## CMakeLists.txt
```
cmake_minimum_required(VERSION 3.20.0)
find_package(Zephyr REQUIRED HINTS $ENV{ZEPHYR_BASE})

set(CMAKE_EXPORT_COMPILE_COMMANDS ON)

project(
  Blinky
  VERSION 0.1
  DESCRIPTION "CPP Blinky application."
  LANGUAGES C CXX)

target_sources(app PRIVATE src/main.cpp)
```

## prj.conf
```kconfig
# C++ Support
CONFIG_CPP=y
CONFIG_REQUIRES_FULL_LIBCPP=y
CONFIG_STD_CPP17=y

# ZPP
CONFIG_USE_ZPP_LIB=y

# Logging
CONFIG_LOG=y

# Kernel Logging
CONFIG_KERNEL_LOG_LEVEL_DBG=y

# ZPP Logging
CONFIG_ZPP_RTOS_LOG_LEVEL_DBG=y
CONFIG_ZPP_DRIVERS_LOG_LEVEL_DBG=y

CONFIG_APP_LOG_LEVEL_DBG=y
```

## boards/qemu_x86.conf
```kconfig
CONFIG_GPIO=y
CONFIG_GPIO_EMUL=y # emulate the GPIO driver
```

## src/main.cpp
```c
// stl
#include <chrono>

// zpp-lib
#include "zpp_include/thread.hpp"
#include "zpp_include/this_thread.hpp"
#include "zpp_include/digital_out.hpp"
#include <zephyr/logging/log.h>

LOG_MODULE_REGISTER(blinky, CONFIG_APP_LOG_LEVEL);

void blink()
{
	zpp_lib::DigitalOut led(zpp_lib::DigitalOut::PinName::LED0);
	using namespace std::literals;
	static std::chrono::milliseconds blinkInterval = 1000ms;

	while (true) {
		led = !led;
		LOG_DBG("Blink!");
		zpp_lib::ThisThread::sleep_for(blinkInterval);
	}
}

int main(void)
{
	LOG_DBG("Running on board %s", CONFIG_BOARD_TARGET);
	LOG_DBG("Starting thread");
	zpp_lib::Thread thread;
	auto res = thread.start(blink);
	if (!res) {
		LOG_ERR("Could not start thread (%d)", static_cast<int>(res.error()));
		return -1;
	}
	res = thread.join();
	if (!res) {
		LOG_ERR("Could not join thread (%d)", static_cast<int>(res.error()));
		return -1;
	}
	return 0;
}
```
